// generated by mBlock5 for mBot Ranger
// codes make you happy

#include <Arduino.h>
#include <Wire.h>
#include <SoftwareSerial.h>
#include <MeAuriga.h>
#include <math.h>

MeEncoderOnBoard Encoder_1(SLOT1);
MeEncoderOnBoard Encoder_2(SLOT2);
MeUltrasonicSensor ultrasonic_10(10);
MeGyro gyro_0(0, 0x69);
MeLightSensor lightsensor_12(12);

void isr_process_encoder1(void)
{
  if(digitalRead(Encoder_1.getPortB()) == 0){
    Encoder_1.pulsePosMinus();
  }else{
    Encoder_1.pulsePosPlus();
  }
}
void isr_process_encoder2(void)
{
  if(digitalRead(Encoder_2.getPortB()) == 0){
    Encoder_2.pulsePosMinus();
  }else{
    Encoder_2.pulsePosPlus();
  }
}
void move(int direction, int speed)
{
  int leftSpeed = 0;
  int rightSpeed = 0;
  if(direction == 1){
    leftSpeed = -speed;
    rightSpeed = speed;
  }else if(direction == 2){
    leftSpeed = speed;
    rightSpeed = -speed;
  }else if(direction == 3){
    leftSpeed = -speed;
    rightSpeed = -speed;
  }else if(direction == 4){
    leftSpeed = speed;
    rightSpeed = speed;
  }
  Encoder_1.setTarPWM(leftSpeed);
  Encoder_2.setTarPWM(rightSpeed);
}
void Forward (){

    move(1, 50 / 100.0 * 255);
    Forward();

}

void _delay(float seconds) {
  if(seconds < 0.0){
    seconds = 0.0;
  }
  long endTime = millis() + seconds * 1000;
  while(millis() < endTime) _loop();
}

void setup() {
  TCCR1A = _BV(WGM10);
  TCCR1B = _BV(CS11) | _BV(WGM12);
  TCCR2A = _BV(WGM21) | _BV(WGM20);
  TCCR2B = _BV(CS21);
  attachInterrupt(Encoder_1.getIntNum(), isr_process_encoder1, RISING);
  attachInterrupt(Encoder_2.getIntNum(), isr_process_encoder2, RISING);
  gyro_0.begin();
  randomSeed((unsigned long)(lightsensor_12.read() * 123456));
  Serial.begin(9600);

  move(1, 30 / 100.0 * 255);
  while(1) {
     //x-angle (converted to radians from degrees since math.h does cos calculations in radians
      float x_angle = gyro_0.getAngle(3);
      if (x_angle < 0) {
        x_angle = 360 + x_angle;
      }
      x_angle = (x_angle * M_PI / 180);

      //get current rotational speed per minute - r/m
      float rpm = Encoder_1.getCurrentSpeed();

      //angular velocity = rpm * 2 * pi / 60
      float angular_velocity = rpm *2 * M_PI / 60;

      //velocity(m/s) = angular_velocity * 0.02 * 100 * (-1)
      float velocity = angular_velocity * 0.02 * 100 * (-1);

      //distance (hypotenuse) = velocity * t (refresh rate (in seconds))
      float distance = velocity * 1;

      //calculate distance traveled in the x-axis
      float xDistance = distance * cos(x_angle);

      //calculate distance traveled in the y-axis
      float yDistance = distance * sin(x_angle);

      Serial.print(xDistance);
      Serial.print(",");

      Serial.print(yDistance);
      Serial.print(",");
      Serial.println();
      
      if(ultrasonic_10.distanceCm() < 11){

          move(2, 35 / 100.0 * 255);
          _delay(1);
          move(2, 0);
          if(random(1, 2 +1) == 2.000000){

              move(4, 35 / 100.0 * 255);
              _delay(1);
              move(4, 0);

          }else{

              move(3, 35 / 100.0 * 255);
              _delay(1);
              move(3, 0);

          }

          move(1, 30 / 100.0 * 255);

      }
      if(gyro_0.getAngle(3) < 360){

      }

      _loop();
  }

}

void _loop() {
  Encoder_1.loop();
  Encoder_2.loop();
  gyro_0.update();
}

void loop() {
  _loop();
}
