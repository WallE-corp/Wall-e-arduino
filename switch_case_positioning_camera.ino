// generated by mBlock5 for mBot Ranger
// codes make you happy

#include <Arduino.h>
#include <Wire.h>
#include <SoftwareSerial.h>
#include <MeAuriga.h>


MeEncoderOnBoard Encoder_1(SLOT1);
MeEncoderOnBoard Encoder_2(SLOT2);
MeLightSensor lightsensor_12(12);
MeLineFollower linefollower_8(8);
MeUltrasonicSensor ultrasonic_10(10);

String object = ("No object detected");

void isr_process_encoder1(void)
{
  if(digitalRead(Encoder_1.getPortB()) == 0){
    Encoder_1.pulsePosMinus();
  }else{
    Encoder_1.pulsePosPlus();
  }
}
void isr_process_encoder2(void)
{
  if(digitalRead(Encoder_2.getPortB()) == 0){
    Encoder_2.pulsePosMinus();
  }else{
    Encoder_2.pulsePosPlus();
  }
}
void move(int direction, int speed)
{
  int leftSpeed = 0;
  int rightSpeed = 0;
  if(direction == 1){
    leftSpeed = -speed;
    rightSpeed = speed;
  }else if(direction == 2){
    leftSpeed = speed;
    rightSpeed = -speed;
  }else if(direction == 3){
    leftSpeed = -speed;
    rightSpeed = -speed;
  }else if(direction == 4){
    leftSpeed = speed;
    rightSpeed = speed;
  }
  Encoder_1.setTarPWM(leftSpeed);
  Encoder_2.setTarPWM(rightSpeed);
}
void Move_Forward (){

    move(1, 30 / 100.0 * 255);

}

void Turn_Left (){

    Encoder_1.setTarPWM(-1 * 38.5/100.0*255);
    Encoder_2.setTarPWM(0/100.0*255);

}
void Stop_moving (){
    Encoder_1.setTarPWM(0);
    Encoder_2.setTarPWM(0);
    _delay(0.5);

}
void Turn_Right (){

    Encoder_1.setTarPWM(-1 * 0/100.0*255);
    Encoder_2.setTarPWM(38.5/100.0*255);

}
void Move_Backward (){

    move(2, 30 / 100.0 * 255);

}

void _delay(float seconds) {
  if(seconds < 0.0){
    seconds = 0.0;
  }
  long endTime = millis() + seconds * 1000;
  while(millis() < endTime) _loop();
}

void setup() {
  Serial.begin(9600);
  TCCR1A = _BV(WGM10);
  TCCR1B = _BV(CS11) | _BV(WGM12);
  TCCR2A = _BV(WGM21) | _BV(WGM20);
  TCCR2B = _BV(CS21);
  attachInterrupt(Encoder_1.getIntNum(), isr_process_encoder1, RISING);
  attachInterrupt(Encoder_2.getIntNum(), isr_process_encoder2, RISING);
  randomSeed((unsigned long)(lightsensor_12.read() * 123456));
  String mode = "";
  char command = 'O';

  while(1) {
    if (Serial.available() > 0 ) {
      mode = Serial.readStringUntil('\n');
      command = mode[0];
    } 
    switch(command) {
      case 'A':
  
        if(ultrasonic_10.distanceCm() < 10){
          object = ("Object detected");
          
          move(2, 35 / 100.0 * 255);
          _delay(1);
          move(2, 0);
          if(random(1, 2 +1) == 2.000000){
              move(4, 35 / 100.0 * 255);
              _delay(1);
              move(4, 0);
          }else{
              move(3, 35 / 100.0 * 255);
              _delay(1);
              move(3, 0);
          }
        }
        else{
          object = ("No object detected");
          
        }
        if(linefollower_8.readSensors() == 0.000000){

          move(2, 35 / 100.0 * 255);
          _delay(1);
          move(2, 0);
          if(random(1, 2 +1) == 2.000000){

              move(4, 35 / 100.0 * 255);
              _delay(1);
              move(4, 0);

          }else{

              move(3, 35 / 100.0 * 255);
              _delay(1);
              move(3, 0);

          }
      }
        Move_Forward();
        break;
      case 'S':
        Stop_moving();
        break;
      case 'L':
        Turn_Left();
        break;
      case 'R':
        Turn_Right();
        break;
      case 'F':
        Move_Forward();
        break;
      case 'B':
        Move_Backward();
        break;
      default:
        Stop_moving();
        break;
    }
      _loop();
  }
}

void _loop() {
  Encoder_1.loop();
  Encoder_2.loop();
}

void loop() {
  _loop();
}
